## CMakeLists.txt
```
cmake_minimum_required(VERSION 3.20.0)

find_package(Zephyr REQUIRED HINTS $ENV{ZEPHYR_BASE})
project(main)

target_sources(app PRIVATE
	src/main.c
)
```

## Kconfig
```
# Application Kconfig for the 802.15.4 <-> WiFi tunnel bridge.

source "Kconfig.zephyr"

menu "Bridge configuration"

config BRIDGE_DIRECT_HOST
	string "Optional IPv4 literal of the peer's direct (port-forwarded) address"
	default ""
	help
	  When non-empty, the bridge tries to connect here first on every
	  reconnect, falling back to BRIDGE_RELAY_HOST if the direct dial
	  fails. Empty means relay-only (the original behavior).

	  Use when one peer has a static public IP plus port-forwarding
	  pointing at the listener-mode bridge on the other side.

config BRIDGE_DIRECT_PORT
	int "TCP port of the peer's direct address"
	default 47000
	range 1 65535
	help
	  Only consulted when BRIDGE_DIRECT_HOST is non-empty.

config BRIDGE_DIRECT_PROBE_PERIOD_S
	int "Re-probe period for direct path while on relay (seconds)"
	default 300
	range 30 3600
	help
	  While the tunnel is running on relay, retry the direct path this
	  often. On a successful direct connect the relay socket is closed
	  and traffic switches over. Only consulted when BRIDGE_DIRECT_HOST
	  is non-empty.

config BRIDGE_TUNNEL_ID
	string "Tunnel identifier shared with the peer bridge"
	default "default"
	help
	  Both bridges in the same logical tunnel must use the same value.
	  Sent in the HELLO message so the relay can pair them.

config BRIDGE_15_4_CHANNEL
	int "IEEE 802.15.4 channel"
	default 23
	range 11 26
	help
	  Pick one that does not overlap with the WiFi channel in use
	  (15, 20, 25, 26 vs WiFi 1/6/11).

config BRIDGE_15_4_PAN_ID
	hex "IEEE 802.15.4 PAN ID"
	default 0xBEEF

config BRIDGE_RX_SLAB_DEPTH
	int "Depth of the radio RX frame slab"
	default 16
	range 4 64
	help
	  Number of in-flight 802.15.4 RX frames buffered in radio_154.c
	  between the driver callback and the radio_to_tunnel_thread.

endmenu
```

## prj.conf
```kconfig
# 802.15.4 <-> WiFi tunnel bridge
# Ported from /Users/brady/ncfsund/sta/prj.conf and adapted:
#   - dropped CONFIG_NET_CONFIG_SETTINGS / NET_CONFIG_MY_IPV4_* (DHCP-only)
#   - renamed CONFIG_STA_SAMPLE_* -> CONFIG_BRIDGE_*
#   - 802.15.4 + MPSL Kconfig is added in step 3 of the implementation plan,
#     not yet enabled here so the WiFi-only build can be confirmed first.

CONFIG_GPIO=y

# IEEE 802.15.4 driver (raw, no Zephyr L2 -- bridge talks to nrf_802154 directly).
CONFIG_NRF_802154_RADIO_DRIVER=y
CONFIG_NET_L2_IEEE802154=n

CONFIG_NET_PROMISCUOUS_MODE=n

# CONFIG_NET_PKT_RX_COUNT=16
# CONFIG_NET_PKT_TX_COUNT=16
# CONFIG_NRF70_RX_NUM_BUFS=16

# # Below section is the primary contributor to SRAM and is currently
# # tuned for performance; revisit if the bridge's RAM gets tight.
# CONFIG_NET_BUF_RX_COUNT=16
# CONFIG_NET_BUF_TX_COUNT=32
# CONFIG_HEAP_MEM_POOL_SIZE=37000
# CONFIG_HEAP_MEM_POOL_IGNORE_MIN=y
# CONFIG_NRF_WIFI_CTRL_HEAP_SIZE=20000
# CONFIG_NRF_WIFI_DATA_HEAP_SIZE=40000
# CONFIG_NET_TC_TX_COUNT=1

# CONFIG_NET_IF_UNICAST_IPV4_ADDR_COUNT=1
# CONFIG_NET_MAX_CONTEXTS=5
# CONFIG_NET_CONTEXT_SYNC_RECV=y

# CONFIG_INIT_STACKS=y

# CONFIG_NET_L2_ETHERNET=y

# CONFIG_NET_SOCKETS_POLL_MAX=10

# Memories
# CONFIG_MAIN_STACK_SIZE=5200
# CONFIG_NET_TX_STACK_SIZE=4096
# CONFIG_NET_RX_STACK_SIZE=4096
# CONFIG_BRIDGE_WIFI_START_STACK_SIZE=5200

# Debugging
CONFIG_STACK_SENTINEL=y
CONFIG_DEBUG_COREDUMP=y
CONFIG_DEBUG_COREDUMP_BACKEND_LOGGING=y
CONFIG_DEBUG_COREDUMP_MEMORY_DUMP_MIN=y
CONFIG_SHELL_CMDS_RESIZE=n

# Kernel options
CONFIG_ENTROPY_GENERATOR=y

# Logging
CONFIG_LOG=y
CONFIG_LOG_BUFFER_SIZE=2048
CONFIG_POSIX_TIMERS=y

CONFIG_PINCTRL=y
```

## boards/nrf54l15dk_nrf54l15_cpuapp.overlay
```dts
/* SRAM size override -- ported from sta/boards/lab8.overlay.
 * Forces the cpuapp SRAM region to the full 256 KB so the WiFi
 * stack has room. Without this, the default split for nRF54L15 may
 * leave too little for the supplicant + nrf70 buffers.
 */

&cpuapp_sram {
	reg = <0x20000000 DT_SIZE_K(256)>;
	ranges = <0x0 0x20000000 DT_SIZE_K(256)>;
};
```

## src/main.c
```c
#include <stdio.h>
#include <zephyr/init.h>
#include <zephyr/kernel.h>
#include <zephyr/drivers/gpio.h>

#include <zephyr/logging/log.h>
	LOG_MODULE_REGISTER(send);

#include "nrf_802154.h"
#include <inttypes.h>

#define PSDU_MAX_SIZE (127u)
#define FCS_LENGTH (2u) /* Length of the Frame Control Sequence */

#define SW0_NODE	DT_ALIAS(sw0)
#if !DT_NODE_HAS_STATUS_OKAY(SW0_NODE)
#error "Unsupported board: sw0 devicetree alias is not defined"
#endif
static const struct gpio_dt_spec button = GPIO_DT_SPEC_GET_OR(SW0_NODE, gpios,
							      {0});
static struct gpio_callback button_cb_data;

#define MESSAGE_SIZE 24
static char send_message[MESSAGE_SIZE] = "sending data from nrf 1";
static uint8_t src_pan_id[2] = {CONFIG_BRIDGE_15_4_PAN_ID & 0xff, (CONFIG_BRIDGE_15_4_PAN_ID >> 8) & 0xff};
static uint8_t src_extended_addr[] = {0xdc, 0xa9, 0x35, 0x7b, 0x73, 0x36, 0xce, 0xf4};
static uint8_t dst_extended_addr[] = {0x50, 0xbe, 0xca, 0xc3, 0x3c, 0x36, 0xce, 0xf4};

static uint8_t pkt[PSDU_MAX_SIZE];


static void pkt_hexdump(uint8_t *pkt, uint8_t length) {
  int i;
  printk("Packet: ");
	for (i=0; i<length; i++) {
		printk("%02x ", *pkt);
		pkt++;
	}
	printk("\n");
}

static void cast_string(uint8_t *pkt, uint8_t length) {
    printk(&pkt[23]);
}

void button_pressed(const struct device *dev, struct gpio_callback *cb, uint32_t pins) {
	size_t len = 24 + FCS_LENGTH + MESSAGE_SIZE;
	// send a tx pkt
	pkt[0] = len; /* Length for nrf_transmit (length of pkt + FCS) */
	pkt[1] = 0x01; /* Frame Control Field */
	pkt[2] = 0xcc; /* Frame Control Field */
	pkt[3] = 0x00; /* Sequence number */
	pkt[4] = src_pan_id[0]; /* Destination PAN ID 0xffff */
	pkt[5] = src_pan_id[1]; /* Destination PAN ID */
	memcpy(&pkt[6], dst_extended_addr, 8); /* Destination extended address */
	memcpy(&pkt[14], src_pan_id, 2); /* Source PAN ID */
	memcpy(&pkt[16], src_extended_addr, 8);/* Source extended address */
	memcpy(&pkt[24], send_message, MESSAGE_SIZE);

	const nrf_802154_transmit_metadata_t metadata = {
			.frame_props = NRF_802154_TRANSMITTED_FRAME_PROPS_DEFAULT_INIT,
			.cca = true
		};

	int err;

	err = nrf_802154_transmit_raw(pkt, &metadata);

	if(err) {
		LOG_ERR("driver could not schedule the transmission procedure. Reason Ox%x", err);
		printk("Reason Ox%x", err);
	}
}

static int rf_setup() {
	LOG_INF("RF setup started");
	// ARG_UNUSED(dev);

	/* nrf radio driver initialization */
	nrf_802154_init();

	return 0;
}

// callback fn when tx starts
void nrf_802154_tx_started(const uint8_t *p_frame) {
	LOG_INF("tx started");
}

// callback fn when tx fails
void nrf_802154_transmit_failed(uint8_t *frame, nrf_802154_tx_error_t error,
	const nrf_802154_transmit_done_metadata_t *p_metadata) {
	LOG_INF("tx failed error %u!", error);
}

// callback fn for successful tx
void nrf_802154_transmitted_raw(uint8_t *p_frame,
	const nrf_802154_transmit_done_metadata_t *p_metadata) {
	LOG_INF("frame was transmitted!");
}

int main(int argc, char **argv) {
	nrf_802154_channel_set(CONFIG_BRIDGE_15_4_CHANNEL);
	LOG_DBG("channel: %u", nrf_802154_channel_get());

	// set the pan_id (2 bytes, little-endian)
	nrf_802154_pan_id_set(src_pan_id);

	// set the extended address (8 bytes, little-endian)
	nrf_802154_extended_address_set(src_extended_addr);

		int ret;

	if (!gpio_is_ready_dt(&button)) {
		printk("Error: button device %s is not ready\n",
		       button.port->name);
		return 0;
	}

	ret = gpio_pin_configure_dt(&button, GPIO_INPUT);
	if (ret != 0) {
		printk("Error %d: failed to configure %s pin %d\n",
		       ret, button.port->name, button.pin);
		return 0;
	}

	ret = gpio_pin_interrupt_configure_dt(&button,
					      GPIO_INT_EDGE_TO_ACTIVE);
	if (ret != 0) {
		printk("Error %d: failed to configure interrupt on %s pin %d\n",
			ret, button.port->name, button.pin);
		return 0;
	}

	gpio_init_callback(&button_cb_data, button_pressed, BIT(button.pin));
	gpio_add_callback(button.port, &button_cb_data);
	printk("Set up button at %s pin %d\n", button.port->name, button.pin);

	if (nrf_802154_receive()) {
		LOG_INF("radio entered rx state");
		return 0;
	}
	
	return 0;
}


void nrf_802154_received_raw(uint8_t *data, int8_t power, uint8_t lqi) {
    printk("received:");
	// pkt_hexdump(data+1, *data - 2U); /* print packet from byte [1, len-2] */
    cast_string(data+1, *data - 2U);
	nrf_802154_buffer_free_raw(data);
}


SYS_INIT(rf_setup, POST_KERNEL, 90);
```

## src/radio_154.c
```c
/*
 * IEEE 802.15.4 driver wrapper.
 *
 * Radio bring-up: driver init via SYS_INIT, then channel / auto-ACK /
 * PAN ID / extended address set in radio_154_init(), then enter RX.
 *
 * RX path: nrf_802154_received_raw allocates a bridge_frame from
 * rx_slab, copies the PSDU bytes (and rssi/lqi) in, and pushes a
 * pointer onto rx_msgq. receive_802_15_4 drains the msgq, copies the
 * frame out for the caller, and frees the slab entry.
 *
 * transmit_802_15_4 is still -ENOSYS (later step).
 */


#include <errno.h>
#include <stdint.h>
#include <string.h>
#include <zephyr/init.h>
#include <zephyr/kernel.h>
#include <zephyr/logging/log.h>
#include <zephyr/sys/printk.h>
#include <zephyr/sys/util.h>

#include "nrf_802154.h"

#define TX_DONE_TIMEOUT_MS 500

LOG_MODULE_REGISTER(radio_154, CONFIG_LOG_DEFAULT_LEVEL);

/* RX slab: backing storage for received bridge_frame instances.
 * Block size is rounded up to a 4-byte multiple as K_MEM_SLAB_DEFINE
 * requires alignment-multiple block size. */
#define MAX_PAYLOAD_SIZE    102
#define MAX_PACKET_SIZE	    127

/* RX msgq: holds bridge_frame * pointers (into rx_slab). */
K_MSGQ_DEFINE(rx_msgq, sizeof(struct bridge_frame *),
	      CONFIG_BRIDGE_RX_SLAB_DEPTH, sizeof(void *));

/* TX is one-in-flight: transmit_802_15_4 blocks on tx_done_sem until the
 * driver invokes transmitted_raw or transmit_failed. The radio retains
 * the buffer pointer until then, so the caller's bridge_frame must stay
 * valid for the duration of the call. */
static K_SEM_DEFINE(tx_done_sem, 0, 1);

static uint8_t src_extended_addr[8] = {0xde, 0xad, 0xbe, 0xef, 0xc0, 0xff, 0xee, 0xaa};
static uint8_t dest_extended_addr[8] = {0x50, 0xbe, 0xca, 0xc3, 0x3c, 0x36, 0xce, 0xf4};
uint8_t src_pan_id[2] = {0xcf, 0xab};


static int rf_setup(void)
{
	LOG_INF("RF setup started");
	printk("RF setup started\n");
	nrf_802154_init();
	return 0;
}

SYS_INIT(rf_setup, POST_KERNEL, 90);

void nrf_802154_received_raw(uint8_t *data, int8_t power, uint8_t lqi)
{
	/* TODO: populate the RX path.
	 *
	 * nrf_802154 hands back PHR + PSDU: data[0] = PSDU length (includes
	 * the 2-byte FCS), data[1..1+data[0]] = PSDU bytes.
	 *
	 *   1. Read psdu_len = data[0]; drop if 0 or > BRIDGE_FRAME_MAX_LEN.
	 *   2. k_mem_slab_alloc(&rx_slab, &frame, K_NO_WAIT). On failure, drop.
	 *   3. frame->len = psdu_len; frame->rssi = power; frame->lqi = lqi;
	 *      memcpy(frame->data, &data[1], psdu_len).
	 *   4. nrf_802154_buffer_free_raw(data) so the radio can reuse the buffer.
	 *   5. k_msgq_put(&rx_msgq, &frame, K_NO_WAIT). If full, k_mem_slab_free.
	 *
	 * Until populated, just release the driver buffer so RX doesn't stall.
	 */

	 
	uint8_t pdsu_len = data[0];
	if (pdsu_len == 0 || pdsu_len > MAX_PACKET_SIZE) {
		return;
	}

	LOG_INF("Received packet: %s", (char *) (data + 30));

	nrf_802154_buffer_free_raw(data);
}

int radio_154_init(void)
{
	nrf_802154_channel_set(CONFIG_BRIDGE_15_4_CHANNEL);
	nrf_802154_auto_ack_set(true);
	LOG_DBG("channel: %u", nrf_802154_channel_get());

	/* PAN ID, little-endian wire order. */
	uint8_t pan_id[2] = {
		CONFIG_BRIDGE_15_4_PAN_ID & 0xff,
		(CONFIG_BRIDGE_15_4_PAN_ID >> 8) & 0xff,
	};
	nrf_802154_pan_id_set(pan_id);

	nrf_802154_extended_address_set(src_extended_addr);

	if (nrf_802154_receive()) {
		LOG_INF("radio entered rx state");
		return 0;
	}
	LOG_ERR("driver could not enter the receive state");
	return -EIO;
}

void nrf_802154_transmitted_raw(uint8_t *p_frame,
	const nrf_802154_transmit_done_metadata_t *p_metadata)
{
	ARG_UNUSED(p_frame);
	ARG_UNUSED(p_metadata);
	k_sem_give(&tx_done_sem);
}

void nrf_802154_transmit_failed(uint8_t *p_frame,
	nrf_802154_tx_error_t error,
	const nrf_802154_transmit_done_metadata_t *p_metadata)
{
	ARG_UNUSED(p_frame);
	ARG_UNUSED(p_metadata);
	LOG_WRN("nrf_802154 TX failed: %u", (unsigned)error);
	k_sem_give(&tx_done_sem);
}

int transmit_802_15_4(uint8_t * buf, size_t len)
{
	if (len > MAX_PAYLOAD_SIZE) {
		LOG_ERR("payload size is too large to transmit");
		return -E2BIG;
	}

	size_t packet_len = 30 + 2 + len;

	uint8_t pkt[MAX_PACKET_SIZE];
	pkt[0] = packet_len; /* Length for nrf_transmit (length of pkt + FCS) */
	pkt[1] = 0x11; /* Frame Control Field */
	pkt[2] = 0x88; /* Frame Control Field */
	pkt[3] = 0x00; /* Sequence number */
	pkt[4] = 0xbb; /* Destination PAN ID 0xffff */
	pkt[5] = 0xbb; /* Destination PAN ID */
	memcpy(&pkt[6], dest_extended_addr, 8); /* Destination extended address */
	memcpy(&pkt[14], src_pan_id, 2); /* Source PAN ID */
	memcpy(&pkt[22], src_extended_addr, 8);/* Source extended address */
	memcpy(&pkt[30], buf, len);

	const nrf_802154_transmit_metadata_t metadata = {
		.frame_props = NRF_802154_TRANSMITTED_FRAME_PROPS_DEFAULT_INIT,
		.cca = true,
	};

	/* bridge_frame is laid out so &pkt->len is the contiguous [PHR][PSDU...]
	 * the radio expects. The driver borrows the buffer until transmitted_raw
	 * or transmit_failed fires, so block here until the callback. */
	k_sem_reset(&tx_done_sem);
	nrf_802154_tx_error_t err = nrf_802154_transmit_raw((uint8_t *)&packet_len, &metadata);
	if (err != NRF_802154_TX_ERROR_NONE) {
		LOG_DBG("transmit_raw rejected: 0x%x", (unsigned)err);
		return -EIO;
	}
	if (k_sem_take(&tx_done_sem, K_MSEC(TX_DONE_TIMEOUT_MS)) != 0) {
		LOG_WRN("transmit_raw: TX-done timeout");
		return -ETIMEDOUT;
	}
	return 0;
}
```

## src/radio_154.h
```c
#ifndef RADIO_154_H_
#define RADIO_154_H_

#include <stddef.h>
#include <stdint.h>

int radio_154_init(void);
int transmit_802_15_4(uint8_t *buf, size_t len);

#endif /* RADIO_154_H_ */
```

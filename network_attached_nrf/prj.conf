## Kconfig
```
# Application Kconfig for the 802.15.4 <-> WiFi tunnel bridge.

source "Kconfig.zephyr"

menu "Bridge configuration"

config BRIDGE_WIFI_START_STACK_SIZE
	int "Stack size for the WiFi start thread"
	default 4096
	help
	  Stack for the helper thread that drives wifi_connect() and waits
	  on DHCP. Ported from the sta/ reference's STA_SAMPLE_START_WIFI_THREAD_STACK_SIZE.

config BRIDGE_RELAY_HOST
	string "Hostname or IPv4 literal of the relay server"
	default "relay.example.com"
	help
	  The bridge opens an outbound TCP connection here on boot.

config BRIDGE_RELAY_PORT
	int "TCP port of the relay server"
	default 47000
	range 1 65535

config BRIDGE_TUNNEL_ID
	string "Tunnel identifier shared with the peer bridge"
	default "default"
	help
	  Both bridges in the same logical tunnel must use the same value.
	  Sent in the HELLO message so the relay can pair them.

config BRIDGE_DIRECT_HOST
	string "IPv4 literal of the peer bridge (direct P2P mode)"
	default ""
	help
	  Leave empty to disable direct P2P; the bridge will only use the relay.
	  If set to a reachable IPv4 address, the bridge tries direct connection first,
	  falls back to relay on failure, and periodically re-probes for upgrade.

config BRIDGE_DIRECT_PORT
	int "TCP port of the peer bridge (direct P2P mode)"
	default 47001
	range 1 65535

config BRIDGE_DIRECT_PROBE_PERIOD_S
	int "Seconds between direct path re-probe attempts (relay-only -> direct upgrade)"
	default 300
	range 10 3600
	help
	  When operating on relay, periodically attempt to connect directly.
	  On success, switch the live connection without dropping frames.

config BRIDGE_15_4_CHANNEL
	int "IEEE 802.15.4 channel"
	default 17
	range 11 26
	help
	  Pick one that does not overlap with the WiFi channel in use
	  (15, 20, 25, 26 vs WiFi 1/6/11).

config BRIDGE_15_4_PAN_ID
	hex "IEEE 802.15.4 PAN ID"
	default 0xBEEF

config BRIDGE_RX_SLAB_DEPTH
	int "Depth of the radio RX frame slab"
	default 16
	range 4 64
	help
	  Number of in-flight 802.15.4 RX frames buffered in radio_154.c
	  between the driver callback and the radio_to_tunnel_thread.

endmenu
```

## prj.conf
```kconfig
# 802.15.4 <-> WiFi tunnel bridge
# Ported from /Users/brady/ncfsund/sta/prj.conf and adapted:
#   - dropped CONFIG_NET_CONFIG_SETTINGS / NET_CONFIG_MY_IPV4_* (DHCP-only)
#   - renamed CONFIG_STA_SAMPLE_* -> CONFIG_BRIDGE_*
#   - 802.15.4 + MPSL Kconfig is added in step 3 of the implementation plan,
#     not yet enabled here so the WiFi-only build can be confirmed first.

CONFIG_GPIO=y

# IEEE 802.15.4 driver (raw, no Zephyr L2 -- bridge talks to nrf_802154 directly).
CONFIG_NRF_802154_RADIO_DRIVER=y
CONFIG_NET_L2_IEEE802154=n

CONFIG_NET_PROMISCUOUS_MODE=y

CONFIG_WIFI=y
CONFIG_WIFI_NRF70=y

# WPA supplicant
CONFIG_WIFI_NM_WPA_SUPPLICANT=y
CONFIG_WIFI_READY_LIB=y
CONFIG_NRF_WIFI_RPU_RECOVERY=y

# WiFi credentials -- placeholder values; override per-build.
CONFIG_WIFI_CREDENTIALS=y
CONFIG_WIFI_CREDENTIALS_STATIC=y
CONFIG_WIFI_CREDENTIALS_STATIC_SSID="Ipsk"
CONFIG_WIFI_CREDENTIALS_STATIC_PASSWORD="16Y1JnJx"

# Networking
CONFIG_NETWORKING=y
CONFIG_NET_SOCKETS=y
CONFIG_NET_LOG=y
CONFIG_NET_IPV4=y
CONFIG_NET_UDP=y
CONFIG_NET_TCP=y
CONFIG_NET_DHCPV4=y

CONFIG_NET_PKT_RX_COUNT=16
CONFIG_NET_PKT_TX_COUNT=16
CONFIG_NRF70_RX_NUM_BUFS=16

# Below section is the primary contributor to SRAM and is currently
# tuned for performance; revisit if the bridge's RAM gets tight.
CONFIG_NET_BUF_RX_COUNT=16
CONFIG_NET_BUF_TX_COUNT=32
CONFIG_HEAP_MEM_POOL_SIZE=37000
CONFIG_HEAP_MEM_POOL_IGNORE_MIN=y
CONFIG_NRF_WIFI_CTRL_HEAP_SIZE=20000
CONFIG_NRF_WIFI_DATA_HEAP_SIZE=40000
CONFIG_NET_TC_TX_COUNT=1

CONFIG_NET_IF_UNICAST_IPV4_ADDR_COUNT=1
CONFIG_NET_MAX_CONTEXTS=5
CONFIG_NET_CONTEXT_SYNC_RECV=y

CONFIG_INIT_STACKS=y

CONFIG_NET_L2_ETHERNET=y

CONFIG_NET_SOCKETS_POLL_MAX=10

# Memories
CONFIG_MAIN_STACK_SIZE=5200
CONFIG_NET_TX_STACK_SIZE=4096
CONFIG_NET_RX_STACK_SIZE=4096
CONFIG_BRIDGE_WIFI_START_STACK_SIZE=5200

# Debugging
CONFIG_STACK_SENTINEL=y
CONFIG_DEBUG_COREDUMP=y
CONFIG_DEBUG_COREDUMP_BACKEND_LOGGING=y
CONFIG_DEBUG_COREDUMP_MEMORY_DUMP_MIN=y
CONFIG_SHELL_CMDS_RESIZE=n

# Kernel options
CONFIG_ENTROPY_GENERATOR=y

# Logging
CONFIG_LOG=y
CONFIG_LOG_BUFFER_SIZE=2048
CONFIG_POSIX_TIMERS=y

# Printing of scan results puts pressure on queues in the new locking
# design in net_mgmt; use a higher timeout for a crowded environment.
CONFIG_NET_MGMT_EVENT_QUEUE_TIMEOUT=5000

# Bridge runtime configuration -- placeholder values, override per-build.
CONFIG_BRIDGE_RELAY_HOST="10.191.70.217"
CONFIG_BRIDGE_RELAY_PORT=47000
CONFIG_BRIDGE_TUNNEL_ID="default"
CONFIG_BRIDGE_DIRECT_HOST=""
CONFIG_BRIDGE_DIRECT_PORT=47001
CONFIG_BRIDGE_DIRECT_PROBE_PERIOD_S=300
CONFIG_BRIDGE_15_4_CHANNEL=17
CONFIG_BRIDGE_15_4_PAN_ID=0xBEEF
CONFIG_BRIDGE_RX_SLAB_DEPTH=16
```

## src/bridge.c
```c
/*
 * Bridge orchestrator -- wires radio_154 and tunnel together.
 *
 * Spawns radio_to_tunnel_thread, the simple loop that composes
 * receive_802_15_4 + tunnel_packet. The complementary
 * tunnel_to_radio_thread plus dedupe ring lands in step 5.
 */

#include "bridge.h"

#include <string.h>

#include <zephyr/kernel.h>
#include <zephyr/logging/log.h>
#include <zephyr/sys/atomic.h>

LOG_MODULE_REGISTER(bridge, CONFIG_LOG_DEFAULT_LEVEL);

#define RADIO_TO_TUNNEL_STACK_SIZE 3072

#define DEDUPE_RING_DEPTH 8
#define DEDUPE_TTL_MS     500

struct dedupe_entry {
	uint32_t timestamp;
	uint8_t  len;
	uint8_t  data[BRIDGE_FRAME_MAX_LEN];
};

static struct dedupe_entry dedupe_ring[DEDUPE_RING_DEPTH];
static int dedupe_idx;
static K_MUTEX_DEFINE(dedupe_mutex);

void bridge_dedupe_remember(const uint8_t *data, uint8_t len)
{
	if (!data || len == 0 || len > BRIDGE_FRAME_MAX_LEN) {
		return;
	}
	k_mutex_lock(&dedupe_mutex, K_FOREVER);
	struct dedupe_entry *e = &dedupe_ring[dedupe_idx];
	e->timestamp = k_uptime_get_32();
	e->len = len;
	memcpy(e->data, data, len);
	dedupe_idx = (dedupe_idx + 1) % DEDUPE_RING_DEPTH;
	k_mutex_unlock(&dedupe_mutex);
}

bool bridge_dedupe_seen(const uint8_t *data, uint8_t len)
{
	if (!data || len == 0 || len > BRIDGE_FRAME_MAX_LEN) {
		return false;
	}
	bool seen = false;
	uint32_t now = k_uptime_get_32();
	k_mutex_lock(&dedupe_mutex, K_FOREVER);
	for (int i = 0; i < DEDUPE_RING_DEPTH; i++) {
		const struct dedupe_entry *e = &dedupe_ring[i];
		if (e->len == len &&
		    (now - e->timestamp) < DEDUPE_TTL_MS &&
		    memcmp(e->data, data, len) == 0) {
			seen = true;
			break;
		}
	}
	k_mutex_unlock(&dedupe_mutex);
	return seen;
}

static atomic_t bridge_started;

static K_THREAD_STACK_DEFINE(radio_to_tunnel_stack, RADIO_TO_TUNNEL_STACK_SIZE);
static struct k_thread radio_to_tunnel_thread_data;

static void radio_to_tunnel_thread(void *a, void *b, void *c)
{
	ARG_UNUSED(a); ARG_UNUSED(b); ARG_UNUSED(c);

	LOG_INF("radio_to_tunnel_thread started");
	struct bridge_frame f;

	while (1) {
		int ret = receive_802_15_4(&f, K_FOREVER);
		if (ret) {
			LOG_DBG("receive_802_15_4: %d", ret);
			k_sleep(K_MSEC(100));  /* avoid tight loop on persistent error */
			continue;
		}

		if (bridge_dedupe_seen(f.data, f.len)) {
			LOG_DBG("dedupe: dropping echo (len=%u)", f.len);
			continue;
		}

		ret = tunnel_packet(&f);
		if (ret) {
			LOG_DBG("tunnel_packet: %d (frame dropped)", ret);
		}
	}
}

int bridge_start(void)
{
	if (atomic_set(&bridge_started, 1) == 1) {
		LOG_DBG("bridge already started, ignoring re-entry");
		return 0;
	}

	LOG_INF("bridge_start: relay=%s:%d tunnel_id='%s' channel=%d pan=0x%04x",
		CONFIG_BRIDGE_RELAY_HOST, CONFIG_BRIDGE_RELAY_PORT,
		CONFIG_BRIDGE_TUNNEL_ID, CONFIG_BRIDGE_15_4_CHANNEL,
		CONFIG_BRIDGE_15_4_PAN_ID);

	int ret = radio_154_init();
	if (ret && ret != -ENOSYS) {
		LOG_ERR("radio_154_init failed: %d (continuing)", ret);
	}

	ret = tunnel_init();
	if (ret) {
		LOG_ERR("tunnel_init failed: %d", ret);
		return ret;
	}

	k_thread_create(&radio_to_tunnel_thread_data, radio_to_tunnel_stack,
			K_THREAD_STACK_SIZEOF(radio_to_tunnel_stack),
			radio_to_tunnel_thread, NULL, NULL, NULL,
			K_PRIO_PREEMPT(7), 0, K_NO_WAIT);
	k_thread_name_set(&radio_to_tunnel_thread_data, "radio2tunnel");

	LOG_INF("bridge: radio_to_tunnel_thread + tunnel_to_radio_thread up");
	return 0;
}
```

## src/bridge.h
```c
/*
 * 802.15.4 <-> WiFi tunnel bridge -- shared types and prototypes.
 */

#ifndef BRIDGE_H_
#define BRIDGE_H_

#include <stdbool.h>
#include <stdint.h>
#include <zephyr/kernel.h>
#include <zephyr/toolchain.h>

#define BRIDGE_FRAME_MAX_LEN 127

/* `len` immediately precedes `data` and the struct is packed so that
 * &pkt->len is the contiguous [PHR][PSDU...] buffer the nrf_802154 radio
 * driver expects for transmit_raw / received_raw. */
struct __packed bridge_frame {
	int8_t  rssi;                             /* valid on receive paths only */
	uint8_t lqi;                              /* valid on receive paths only */
	uint8_t len;                              /* PHY payload length, <= BRIDGE_FRAME_MAX_LEN */
	uint8_t data[BRIDGE_FRAME_MAX_LEN];       /* raw 802.15.4 frame bytes */
};

/* Data path: four blocking primitives, returns 0 on success or a negative errno. */

/* Send a captured 802.15.4 frame through the WiFi tunnel to the relay. */
int tunnel_packet(const struct bridge_frame *pkt);

/* Receive a frame from the relay, stripping the tunnel header. */
int receive_tunnel_packet(struct bridge_frame *pkt, k_timeout_t timeout);

/* Transmit a frame on the local 802.15.4 radio. */
int transmit_802_15_4(const struct bridge_frame *pkt);

/* Receive a frame captured by the local 802.15.4 radio. Blocks up to `timeout`. */
int receive_802_15_4(struct bridge_frame *pkt, k_timeout_t timeout);

/* Number of frames currently buffered in radio_154's RX queue. */
unsigned int radio_154_rx_pending(void);

/* Drop all currently-buffered RX frames (releases their slab entries). */
void radio_154_rx_purge(void);

/* One-time initialization helpers used by bridge_start(). */
int radio_154_init(void);
int tunnel_init(void);

/* Dedupe: bridge_dedupe_remember is called just before the bridge transmits a
 * frame on its local 802.15.4 radio. bridge_dedupe_seen is called for each
 * frame just received off the air; if it returns true the frame is an echo of
 * something we just transmitted (or a peer's echo of our TX) and should be
 * dropped instead of tunneled, breaking the loop. Entries expire on a short
 * timer, so a stale TX recording can't shadow a legitimate frame for long. */
void bridge_dedupe_remember(const uint8_t *data, uint8_t len);
bool bridge_dedupe_seen(const uint8_t *data, uint8_t len);

/* Start the bridge: initializes the radio + tunnel modules and spawns the two glue threads.
 * Safe to call once after WiFi+DHCP are up. Subsequent calls are no-ops.
 */
int bridge_start(void);

#endif /* BRIDGE_H_ */
```

## src/radio_154.c
```c
/*
 * IEEE 802.15.4 driver wrapper.
 *
 * Radio bring-up: driver init via SYS_INIT, then channel / auto-ACK /
 * PAN ID / extended address set in radio_154_init(), then enter RX.
 *
 * RX path: nrf_802154_received_raw allocates a bridge_frame from
 * rx_slab, copies the PSDU bytes (and rssi/lqi) in, and pushes a
 * pointer onto rx_msgq. receive_802_15_4 drains the msgq, copies the
 * frame out for the caller, and frees the slab entry.
 *
 * transmit_802_15_4 is still -ENOSYS (later step).
 */

#include "bridge.h"

#include <errno.h>
#include <stdint.h>
#include <zephyr/init.h>
#include <zephyr/kernel.h>
#include <zephyr/logging/log.h>
#include <zephyr/sys/printk.h>
#include <zephyr/sys/util.h>

#include "nrf_802154.h"

LOG_MODULE_REGISTER(radio_154, CONFIG_LOG_DEFAULT_LEVEL);

/* RX slab: backing storage for received bridge_frame instances.
 * Block size is rounded up to a 4-byte multiple as K_MEM_SLAB_DEFINE
 * requires alignment-multiple block size. */
#define RX_SLAB_BLOCK_SIZE  ROUND_UP(sizeof(struct bridge_frame), 4)
#define RX_SLAB_ALIGN       4

K_MEM_SLAB_DEFINE(rx_slab, RX_SLAB_BLOCK_SIZE,
		  CONFIG_BRIDGE_RX_SLAB_DEPTH, RX_SLAB_ALIGN);

/* RX msgq: holds bridge_frame * pointers (into rx_slab). */
K_MSGQ_DEFINE(rx_msgq, sizeof(struct bridge_frame *),
	      CONFIG_BRIDGE_RX_SLAB_DEPTH, sizeof(void *));

static int rf_setup(void)
{
	LOG_INF("RF setup started");
	printk("RF setup started\n");
	nrf_802154_init();
	return 0;
}

SYS_INIT(rf_setup, POST_KERNEL, 90);

void nrf_802154_received_raw(uint8_t *data, int8_t power, uint8_t lqi)
{
	/* nrf_802154 hands back PHR + PSDU: data[0] = PSDU length (includes
	 * the 2-byte FCS), data[1..1+data[0]] = PSDU bytes.
	 * Allocate a bridge_frame, populate it, push to rx_msgq. */
	uint8_t pdsu_len = data[0];
	if (pdsu_len == 0 || pdsu_len > BRIDGE_FRAME_MAX_LEN) {
		return;
	}

	struct bridge_frame * frame;
	if (k_mem_slab_alloc(&rx_slab, (void **) &frame, K_NO_WAIT) != 0) {
		return;
	}

	frame->len = pdsu_len;
	frame->rssi = power;
	frame->lqi = lqi;
	memcpy(frame->data, data + 1, pdsu_len);

	nrf_802154_buffer_free_raw(data);

	LOG_INF("Received 802.15.4 packet");

	if (k_msgq_put(&rx_msgq, &frame, K_NO_WAIT) == 0) {
		LOG_DBG("Added message to the queue");
	} else {
		LOG_WRN("Msg queue is full");
	}
}

int radio_154_init(void)
{
	nrf_802154_channel_set(CONFIG_BRIDGE_15_4_CHANNEL);
	nrf_802154_auto_ack_set(false);
	LOG_DBG("channel: %u", nrf_802154_channel_get());

	/* PAN ID, little-endian wire order. */
	// uint8_t pan_id[2] = {
	// 	CONFIG_BRIDGE_15_4_PAN_ID & 0xff,
	// 	(CONFIG_BRIDGE_15_4_PAN_ID >> 8) & 0xff,
	// };
	// nrf_802154_pan_id_set(pan_id);

	/* Enable promiscuous mode to capture all frames on the channel,
	 * regardless of destination address or PAN ID. */
	nrf_802154_promiscuous_set(true);

	// uint8_t extended_addr[8] = {
	// 	0x50, 0xbe, 0xca, 0xc3, 0x3c, 0x36, 0xce, 0xf4,
	// };
	// nrf_802154_extended_address_set(extended_addr);

	if (nrf_802154_receive()) {
		LOG_INF("radio entered rx state");
		return 0;
	}
	LOG_ERR("driver could not enter the receive state");
	return -EIO;
}

static K_SEM_DEFINE(tx_done_sem, 0, 1);

/* TX buffer: must be persistent (static) since nrf_802154_transmit_raw uses zero-copy.
 * The driver stores a pointer to this buffer and transmits it asynchronously. */
static uint8_t tx_buf[1 + BRIDGE_FRAME_MAX_LEN];

void nrf_802154_transmitted_raw(uint8_t *p_frame,
	const nrf_802154_transmit_done_metadata_t *p_metadata) {
	ARG_UNUSED(p_frame);
	ARG_UNUSED(p_metadata);
	k_sem_give(&tx_done_sem);
}

int transmit_802_15_4(const struct bridge_frame *pkt)
{
	if (!pkt || pkt->len > BRIDGE_FRAME_MAX_LEN) {
		return -EINVAL;
	}

	/* nrf_802154_transmit_raw expects [PHR][PSDU] where PHR = length of PSDU.
	 * bridge_frame.len is the PSDU length; populate the static TX buffer. */
	tx_buf[0] = pkt->len;
	memcpy(tx_buf + 1, pkt->data, pkt->len);

	const nrf_802154_transmit_metadata_t metadata = {
		.frame_props = NRF_802154_TRANSMITTED_FRAME_PROPS_DEFAULT_INIT,
		.cca = true
	};

	nrf_802154_tx_error_t tx_error = nrf_802154_transmit_raw(tx_buf, &metadata);
	if (tx_error != NRF_802154_TX_ERROR_NONE) {
		LOG_ERR("transmit_raw failed with error code: 0x%02x", tx_error);
		return -EIO;
	}

	/* Wait for TX-done callback. Use a 1s timeout to avoid indefinite hang
	 * if the callback is somehow lost. */
	if (k_sem_take(&tx_done_sem, K_SECONDS(1)) != 0) {
		LOG_WRN("transmit_802_15_4: TX-done callback timeout");
		return -ETIMEDOUT;
	}
    LOG_INF("802.15.4 TX succeeded");


	return 0;
}

int receive_802_15_4(struct bridge_frame *pkt, k_timeout_t timeout)
{
	if (pkt == NULL) {
		return -EINVAL;
	}

	// get msg from q
	struct bridge_frame * frame;
	if(k_msgq_get(&rx_msgq, &frame, timeout) != 0) {
		return -EAGAIN;
	}

	// copy packet and free
	memcpy(pkt, frame, sizeof(*pkt));
	k_mem_slab_free(&rx_slab, frame);
	
	return 0;
}

unsigned int radio_154_rx_pending(void)
{
	return k_msgq_num_used_get(&rx_msgq);
}

void radio_154_rx_purge(void)
{
	struct bridge_frame *frame;
	while (k_msgq_get(&rx_msgq, &frame, K_NO_WAIT) == 0) {
		k_mem_slab_free(&rx_slab, frame);
	}
}
```

## src/tunnel.c
```c
/*
 * TCP tunnel to the relay server.
 *
 * Establishes a long-lived TCP socket to BRIDGE_RELAY_HOST:BRIDGE_RELAY_PORT,
 * sends a HELLO carrying BRIDGE_TUNNEL_ID, and reconnects with backoff
 * on failure. tunnel_packet() sends FRAME messages; receive_tunnel_packet()
 * receives them with proper TCP framing (recv_all).
 *
 * Supports dual-path: direct P2P when BRIDGE_DIRECT_HOST is configured,
 * falls back to relay, and periodically re-probes for upgrade.
 * BRIDGE_RELAY_HOST is an IPv4 literal parsed via zsock_inet_pton.
 */

#include "bridge.h"

#include <errno.h>
#include <stdbool.h>
#include <stdint.h>
#include <string.h>

#include <zephyr/kernel.h>
#include <zephyr/logging/log.h>
#include <zephyr/net/socket.h>
#include <zephyr/sys/util.h>
#include <zephyr/toolchain.h>

LOG_MODULE_REGISTER(tunnel, CONFIG_LOG_DEFAULT_LEVEL);

#define TUNNEL_MAGIC       0x34353142u  /* 'B154' little-endian */
#define TUNNEL_VERSION     1
#define MSG_HELLO          1
#define MSG_FRAME          2
#define HELLO_PAYLOAD_LEN  16

#define RECONNECT_BACKOFF_MIN_MS  1000
#define RECONNECT_BACKOFF_MAX_MS  30000

#define CONNECTION_THREAD_STACK   4096
#define RECV_THREAD_STACK 	      4096

struct __packed tunnel_hdr {
	uint32_t magic;
	uint8_t  version;
	uint8_t  msg_type;
	uint16_t seq;
	int8_t   rssi;
	uint8_t  lqi;
	uint8_t  len;
	uint8_t  _pad;
};

BUILD_ASSERT(sizeof(struct tunnel_hdr) == 12, "tunnel_hdr must be 12 bytes");

static K_MUTEX_DEFINE(fd_mutex);
static int sock_fd = -1;            /* protected by fd_mutex */
static K_SEM_DEFINE(reconnect_sem, 0, 1);

static K_THREAD_STACK_DEFINE(connection_stack, CONNECTION_THREAD_STACK);
static struct k_thread connection_thread;

static K_THREAD_STACK_DEFINE(recv_thread_stack, RECV_THREAD_STACK);
static struct k_thread recv_thread;

static uint16_t tx_seq;              /* only touched by tunnel_packet */

/* Send `len` bytes; loops over short writes. Returns 0 or -errno. */
static int send_all(int fd, const void *buf, size_t len)
{
	const uint8_t *p = buf;
	while (len > 0) {
		int n = zsock_send(fd, p, len, 0);
		if (n < 0) {
			return -errno;
		}
		if (n == 0) {
			return -ECONNRESET;
		}
		p += n;
		len -= n;
	}
	return 0;
}

/* Read exactly `len` bytes; loops over short reads. Returns 0 or -errno. */
static int recv_all(int fd, void *buf, size_t len)
{
	uint8_t *p = buf;
	while (len > 0) {
		int n = zsock_recv(fd, p, len, 0);
		if (n < 0) {
			return -errno;
		}
		if (n == 0) {
			return -ECONNRESET;
		}
		p += n;
		len -= n;
	}
	return 0;
}

/* Open + connect + HELLO to (host, port). Returns the connected fd, or a
 * negative errno. Used for both the direct path and the relay fallback. */
static int do_dial(const char *host, uint16_t port)
{
	struct sockaddr_in addr = {
		.sin_family = AF_INET,
		.sin_port = htons(port),
	};

	if (zsock_inet_pton(AF_INET, host, &addr.sin_addr) != 1) {
		LOG_ERR("'%s' is not a valid IPv4 literal", host);
		return -EINVAL;
	}

	int fd = zsock_socket(AF_INET, SOCK_STREAM, IPPROTO_TCP);
	if (fd < 0) {
		return -errno;
	}

	if (zsock_connect(fd, (struct sockaddr *)&addr, sizeof(addr)) < 0) {
		int e = -errno;
		zsock_close(fd);
		return e;
	}

	int one = 1;
	if (zsock_setsockopt(fd, IPPROTO_TCP, TCP_NODELAY, &one, sizeof(one)) < 0) {
		LOG_WRN("TCP_NODELAY failed: %d (continuing without it)", errno);
	}

	/* HELLO: header + 16-byte zero-padded ASCII tunnel_id. */
	uint8_t buf[sizeof(struct tunnel_hdr) + HELLO_PAYLOAD_LEN] = {0};
	struct tunnel_hdr hdr = {
		.magic = TUNNEL_MAGIC,
		.version = TUNNEL_VERSION,
		.msg_type = MSG_HELLO,
		.len = HELLO_PAYLOAD_LEN,
	};
	memcpy(buf, &hdr, sizeof(hdr));
	strncpy((char *)buf + sizeof(hdr), CONFIG_BRIDGE_TUNNEL_ID, HELLO_PAYLOAD_LEN);

	int ret = send_all(fd, buf, sizeof(buf));
	if (ret < 0) {
		LOG_WRN("HELLO send failed: %d", ret);
		zsock_close(fd);
		return ret;
	}

	return fd;
}

static inline bool direct_configured(void)
{
	return CONFIG_BRIDGE_DIRECT_HOST[0] != '\0';
}

/* Close the fd if it still matches `expected_fd`, and signal a reconnect. */
static void mark_dead(int expected_fd)
{
	bool need_signal = false;
	k_mutex_lock(&fd_mutex, K_FOREVER);
	if (sock_fd >= 0 && sock_fd == expected_fd) {
		zsock_close(sock_fd);
		sock_fd = -1;
		need_signal = true;
	}
	k_mutex_unlock(&fd_mutex);
	if (need_signal) {
		k_sem_give(&reconnect_sem);
	}
}

enum tunnel_path { PATH_DIRECT, PATH_RELAY };

static const char *path_name(enum tunnel_path p)
{
	return p == PATH_DIRECT ? "direct" : "relay";
}

/* Try the direct path first if configured, then fall back to relay.
 * Sets *path_out to whichever succeeded. Returns the connected fd, or
 * a negative errno if both failed. */
static int dial_with_fallback(enum tunnel_path *path_out)
{
	if (direct_configured()) {
		LOG_INF("dialing direct %s:%d",
			CONFIG_BRIDGE_DIRECT_HOST, CONFIG_BRIDGE_DIRECT_PORT);
		int fd = do_dial(CONFIG_BRIDGE_DIRECT_HOST, CONFIG_BRIDGE_DIRECT_PORT);
		if (fd >= 0) {
			*path_out = PATH_DIRECT;
			return fd;
		}
		LOG_INF("direct dial failed: %d, falling back to relay", fd);
	}

	LOG_INF("dialing relay %s:%d",
		CONFIG_BRIDGE_RELAY_HOST, CONFIG_BRIDGE_RELAY_PORT);
	int fd = do_dial(CONFIG_BRIDGE_RELAY_HOST, CONFIG_BRIDGE_RELAY_PORT);
	if (fd >= 0) {
		*path_out = PATH_RELAY;
		return fd;
	}
	return fd;
}

static void connection_thread_fn(void *a, void *b, void *c)
{
	ARG_UNUSED(a); ARG_UNUSED(b); ARG_UNUSED(c);

	LOG_INF("tunnel connection thread started");
	uint32_t backoff_ms = RECONNECT_BACKOFF_MIN_MS;

	while (1) {
		enum tunnel_path active;
		int fd = dial_with_fallback(&active);
		if (fd < 0) {
			LOG_WRN("all dials failed: %d, retrying in %u ms",
				fd, backoff_ms);
			k_sleep(K_MSEC(backoff_ms));
			backoff_ms = MIN(backoff_ms * 2, RECONNECT_BACKOFF_MAX_MS);
			continue;
		}

		backoff_ms = RECONNECT_BACKOFF_MIN_MS;
		int orphan;
		k_mutex_lock(&fd_mutex, K_FOREVER);
		orphan = sock_fd;
		sock_fd = fd;
		k_mutex_unlock(&fd_mutex);
		if (orphan >= 0) {
			/* Inner loop broke with a still-live fd (rare: probe-success
			 * raced with mark_dead). Close it so it doesn't leak. */
			zsock_close(orphan);
		}
		LOG_INF("tunnel up via %s (fd=%d, tunnel_id='%s')",
			path_name(active), fd, CONFIG_BRIDGE_TUNNEL_ID);

		/* Inner loop: while the current connection is alive, either wait
		 * forever (on direct, or on relay with no direct configured) or
		 * wake periodically to re-probe direct. */
		while (1) {
			k_timeout_t wait = K_FOREVER;
			if (active == PATH_RELAY && direct_configured()) {
				wait = K_SECONDS(CONFIG_BRIDGE_DIRECT_PROBE_PERIOD_S);
			}

			if (k_sem_take(&reconnect_sem, wait) == 0) {
				/* Connection died (mark_dead signalled). Re-dial from
				 * scratch -- direct first, then relay. */
				LOG_INF("tunnel: %s path dropped, reconnecting",
					path_name(active));
				break;
			}

			/* Timeout fired: we're on relay, try a direct probe. If it
			 * connects + HELLO, swap fds and continue on direct. */
			LOG_DBG("re-probing direct path");
			int probe_fd = do_dial(CONFIG_BRIDGE_DIRECT_HOST,
					       CONFIG_BRIDGE_DIRECT_PORT);
			if (probe_fd < 0) {
				LOG_DBG("direct re-probe failed: %d", probe_fd);
				continue;
			}

			LOG_INF("direct path is up; switching from relay");
			int old_fd;
			k_mutex_lock(&fd_mutex, K_FOREVER);
			old_fd = sock_fd;
			sock_fd = probe_fd;
			k_mutex_unlock(&fd_mutex);
			if (old_fd >= 0) {
				zsock_close(old_fd);
			}
			active = PATH_DIRECT;
		}
	}
}

static void receive_thread_fn(void * a, void * b, void * c) {
	ARG_UNUSED(a); ARG_UNUSED(b); ARG_UNUSED(c);

	LOG_INF("tunnel_to_radio_thread started");
	while (1) {
		struct bridge_frame pkt;
		int ret = receive_tunnel_packet(&pkt, K_FOREVER);
		if (ret) {
			/* -ENOTCONN / -EPROTO / -ECONNRESET: connection thread will
			 * reconnect; back off briefly to avoid spinning. */
			k_sleep(K_MSEC(100));
			continue;
		}

		/* Record before TX so the radio echo / peer rebroadcast can be
		 * suppressed even if it arrives before transmit_802_15_4 returns. */
		bridge_dedupe_remember(pkt.data, pkt.len);

		ret = transmit_802_15_4(&pkt);
		if (ret) {
			LOG_DBG("transmit_802_15_4: %d (frame dropped)", ret);
		}
	}
}

int tunnel_init(void)
{
	k_thread_create(&connection_thread, connection_stack,
			K_THREAD_STACK_SIZEOF(connection_stack),
			connection_thread_fn, NULL, NULL, NULL,
			K_PRIO_PREEMPT(7), 0, K_NO_WAIT);
	k_thread_name_set(&connection_thread, "tunnel-conn");

	k_thread_create(&recv_thread, recv_thread_stack,
			K_THREAD_STACK_SIZEOF(recv_thread_stack),
			receive_thread_fn, NULL, NULL, NULL,
			K_PRIO_PREEMPT(7), 0, K_NO_WAIT);
	k_thread_name_set(&recv_thread, "recv-tun");

	return 0;
}

int tunnel_packet(const struct bridge_frame *pkt)
{
	if (!pkt || pkt->len > BRIDGE_FRAME_MAX_LEN) {
		return -EINVAL;
	}

	int fd;
	k_mutex_lock(&fd_mutex, K_FOREVER);
	fd = sock_fd;
	k_mutex_unlock(&fd_mutex);

	if (fd < 0) {
		return -ENOTCONN;
	}

	/* One send: header + payload concatenated, so the relay reads a
	 * complete (hdr + len) unit even if the underlying TCP segments
	 * fragment differently. */
	uint8_t buf[sizeof(struct tunnel_hdr) + BRIDGE_FRAME_MAX_LEN];
	struct tunnel_hdr hdr = {
		.magic = TUNNEL_MAGIC,
		.version = TUNNEL_VERSION,
		.msg_type = MSG_FRAME,
		.seq = tx_seq++,
		.rssi = pkt->rssi,
		.lqi = pkt->lqi,
		.len = pkt->len,
	};
	memcpy(buf, &hdr, sizeof(hdr));
	if (pkt->len > 0) {
		memcpy(buf + sizeof(hdr), pkt->data, pkt->len);
	}

	int ret = send_all(fd, buf, sizeof(hdr) + pkt->len);
	if (ret < 0) {
		LOG_DBG("tunnel_packet send failed: %d, marking fd dead", ret);
		mark_dead(fd);
	}
	return ret;
}

int receive_tunnel_packet(struct bridge_frame *pkt, k_timeout_t timeout)
{
	ARG_UNUSED(timeout);

	if (!pkt) {
		return -EINVAL;
	}

	int fd;
	k_mutex_lock(&fd_mutex, K_FOREVER);
	fd = sock_fd;
	k_mutex_unlock(&fd_mutex);
	if (fd < 0) {
		return -ENOTCONN;
	}

	struct tunnel_hdr hdr;
	int ret = recv_all(fd, &hdr, sizeof(hdr));
	if (ret < 0) {
		LOG_DBG("recv hdr failed: %d, marking fd dead", ret);
		mark_dead(fd);
		return ret;
	}

	if (hdr.magic != TUNNEL_MAGIC || hdr.version != TUNNEL_VERSION) {
		LOG_WRN("bad header magic=%#x ver=%u, closing", hdr.magic, hdr.version);
		mark_dead(fd);
		return -EPROTO;
	}
	if (hdr.len > BRIDGE_FRAME_MAX_LEN) {
		LOG_WRN("oversized frame len=%u, closing", hdr.len);
		mark_dead(fd);
		return -EPROTO;
	}

	if (hdr.msg_type != MSG_FRAME) {
		LOG_WRN("unexpected msg_type=%u, draining %u bytes",
			hdr.msg_type, hdr.len);
		if (hdr.len > 0) {
			uint8_t scratch[BRIDGE_FRAME_MAX_LEN];
			ret = recv_all(fd, scratch, hdr.len);
			if (ret < 0) {
				mark_dead(fd);
				return ret;
			}
		}
		return -EAGAIN;
	}

	pkt->len = hdr.len;
	pkt->rssi = hdr.rssi;
	pkt->lqi = hdr.lqi;
	if (hdr.len > 0) {
		ret = recv_all(fd, pkt->data, hdr.len);
		if (ret < 0) {
			LOG_DBG("recv body failed: %d, marking fd dead", ret);
			mark_dead(fd);
			return ret;
		}
	}

	return 0;
}
```

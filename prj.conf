## CMakeLists.txt
```
cmake_minimum_required(VERSION 3.20.0)

find_package(Zephyr REQUIRED HINTS $ENV{ZEPHYR_BASE})
project(main)

target_sources(app PRIVATE
	src/main.c
	src/bridge.c
	src/radio_154.c
	src/tunnel.c
)
```

## prj.conf
```kconfig
# 802.15.4 <-> WiFi tunnel bridge
# Ported from /Users/brady/ncfsund/sta/prj.conf and adapted:
#   - dropped CONFIG_NET_CONFIG_SETTINGS / NET_CONFIG_MY_IPV4_* (DHCP-only)
#   - renamed CONFIG_STA_SAMPLE_* -> CONFIG_BRIDGE_*
#   - 802.15.4 + MPSL Kconfig is added in step 3 of the implementation plan,
#     not yet enabled here so the WiFi-only build can be confirmed first.

CONFIG_GPIO=y

# IEEE 802.15.4 driver (raw, no Zephyr L2 -- bridge talks to nrf_802154 directly).
CONFIG_NRF_802154_RADIO_DRIVER=y
CONFIG_NET_L2_IEEE802154=n

CONFIG_NET_PROMISCUOUS_MODE=y

CONFIG_WIFI=y
CONFIG_WIFI_NRF70=y

# WPA supplicant
CONFIG_WIFI_NM_WPA_SUPPLICANT=y
CONFIG_WIFI_READY_LIB=y
CONFIG_NRF_WIFI_RPU_RECOVERY=y

# WiFi credentials -- placeholder values; override per-build.
CONFIG_WIFI_CREDENTIALS=y
CONFIG_WIFI_CREDENTIALS_STATIC=y
CONFIG_WIFI_CREDENTIALS_STATIC_SSID="Ipsk"
CONFIG_WIFI_CREDENTIALS_STATIC_PASSWORD="16Y1JnJx"

# Networking
CONFIG_NETWORKING=y
CONFIG_NET_SOCKETS=y
CONFIG_NET_LOG=y
CONFIG_NET_IPV4=y
CONFIG_NET_UDP=y
CONFIG_NET_TCP=y
CONFIG_NET_DHCPV4=y

CONFIG_NET_PKT_RX_COUNT=16
CONFIG_NET_PKT_TX_COUNT=16
CONFIG_NRF70_RX_NUM_BUFS=16

# Below section is the primary contributor to SRAM and is currently
# tuned for performance; revisit if the bridge's RAM gets tight.
CONFIG_NET_BUF_RX_COUNT=16
CONFIG_NET_BUF_TX_COUNT=32
CONFIG_HEAP_MEM_POOL_SIZE=37000
CONFIG_HEAP_MEM_POOL_IGNORE_MIN=y
CONFIG_NRF_WIFI_CTRL_HEAP_SIZE=20000
CONFIG_NRF_WIFI_DATA_HEAP_SIZE=40000
CONFIG_NET_TC_TX_COUNT=1

CONFIG_NET_IF_UNICAST_IPV4_ADDR_COUNT=1
CONFIG_NET_MAX_CONTEXTS=5
CONFIG_NET_CONTEXT_SYNC_RECV=y

CONFIG_INIT_STACKS=y

CONFIG_NET_L2_ETHERNET=y

CONFIG_NET_SOCKETS_POLL_MAX=10

# Memories
CONFIG_MAIN_STACK_SIZE=5200
CONFIG_NET_TX_STACK_SIZE=4096
CONFIG_NET_RX_STACK_SIZE=4096
CONFIG_BRIDGE_WIFI_START_STACK_SIZE=5200

# Debugging
CONFIG_STACK_SENTINEL=y
CONFIG_DEBUG_COREDUMP=y
CONFIG_DEBUG_COREDUMP_BACKEND_LOGGING=y
CONFIG_DEBUG_COREDUMP_MEMORY_DUMP_MIN=y
CONFIG_SHELL_CMDS_RESIZE=n

# Kernel options
CONFIG_ENTROPY_GENERATOR=y

# Logging
CONFIG_LOG=y
CONFIG_LOG_BUFFER_SIZE=2048
CONFIG_POSIX_TIMERS=y

# Printing of scan results puts pressure on queues in the new locking
# design in net_mgmt; use a higher timeout for a crowded environment.
CONFIG_NET_MGMT_EVENT_QUEUE_TIMEOUT=5000

# Bridge runtime configuration -- placeholder values, override per-build.
CONFIG_BRIDGE_RELAY_HOST="192.168.2.1"
CONFIG_BRIDGE_RELAY_PORT=47000
CONFIG_BRIDGE_TUNNEL_ID="default"
CONFIG_BRIDGE_15_4_CHANNEL=25
CONFIG_BRIDGE_15_4_PAN_ID=0xBEEF
CONFIG_BRIDGE_RX_SLAB_DEPTH=16
```

## src/main.c
```c
/*
 * 802.15.4 <-> WiFi tunnel bridge -- main entry.
 *
 * WiFi-bringup flow ported from /Users/brady/ncfsund/sta/src/main.c
 * with the following changes:
 *   - Dropped the QSPI encryption block (only applied to nRF7002DK).
 *   - Dropped the BSSID print in cmd_wifi_status() (removes the
 *     net_private.h private-API dependency).
 *   - bridge_start() is invoked once after DHCP is bound.
 *
 * The previous EmbW_IoT/src/main.c (a small 802.15.4 RX skeleton) is
 * preserved as comments inside src/radio_154.c -- it becomes the basis
 * of radio_154_init() in step 3.
 */

#include "bridge.h"

#include <stdio.h>
#include <stdlib.h>

#include <zephyr/init.h>
#include <zephyr/kernel.h>
#include <zephyr/logging/log.h>
#include <zephyr/drivers/gpio.h>
#include <zephyr/net/net_event.h>
#include <zephyr/net/net_if.h>
#include <zephyr/net/wifi_mgmt.h>

#ifdef CONFIG_WIFI_READY_LIB
#include <net/wifi_ready.h>
#endif

LOG_MODULE_REGISTER(main, CONFIG_LOG_DEFAULT_LEVEL);

#define WIFI_SHELL_MGMT_EVENTS (NET_EVENT_WIFI_CONNECT_RESULT | \
				NET_EVENT_WIFI_DISCONNECT_RESULT)

#define STATUS_POLLING_MS  300
#define LED_SLEEP_TIME_MS  100

#define LED0_NODE DT_ALIAS(led0)
static const struct gpio_dt_spec led = GPIO_DT_SPEC_GET(LED0_NODE, gpios);

static struct net_mgmt_event_callback wifi_mgmt_cb;
static struct net_mgmt_event_callback net_mgmt_cb;

#ifdef CONFIG_WIFI_READY_LIB
static K_SEM_DEFINE(wifi_ready_state_changed_sem, 0, 1);
static bool wifi_ready_status;
#endif

static struct {
	uint8_t connected            : 1;
	uint8_t connect_result       : 1;
	uint8_t disconnect_requested : 1;
	uint8_t _unused              : 5;
} context;

static void toggle_led(void)
{
	if (!device_is_ready(led.port)) {
		LOG_ERR("LED device not ready");
		return;
	}
	if (gpio_pin_configure_dt(&led, GPIO_OUTPUT_ACTIVE) < 0) {
		LOG_ERR("Failed to configure LED pin");
		return;
	}
	while (1) {
		if (context.connected) {
			gpio_pin_toggle_dt(&led);
		} else {
			gpio_pin_set_dt(&led, 0);
		}
		k_msleep(LED_SLEEP_TIME_MS);
	}
}
K_THREAD_DEFINE(led_thread_id, 1024, toggle_led, NULL, NULL, NULL, 7, 0, 0);

static int log_wifi_status(void)
{
	struct net_if *iface = net_if_get_default();
	struct wifi_iface_status status = { 0 };

	if (net_mgmt(NET_REQUEST_WIFI_IFACE_STATUS, iface, &status, sizeof(status))) {
		LOG_INF("WiFi status request failed");
		return -ENOEXEC;
	}

	LOG_INF("==================");
	LOG_INF("State: %s", wifi_state_txt(status.state));
	if (status.state >= WIFI_STATE_ASSOCIATED) {
		LOG_INF("Mode: %s", wifi_mode_txt(status.iface_mode));
		LOG_INF("Link Mode: %s", wifi_link_mode_txt(status.link_mode));
		LOG_INF("SSID: %.32s", status.ssid);
		LOG_INF("Band: %s", wifi_band_txt(status.band));
		LOG_INF("Channel: %d", status.channel);
		LOG_INF("Security: %s", wifi_security_txt(status.security));
		LOG_INF("MFP: %s", wifi_mfp_txt(status.mfp));
		LOG_INF("RSSI: %d", status.rssi);
	}
	return 0;
}

static void handle_wifi_connect_result(struct net_mgmt_event_callback *cb)
{
	const struct wifi_status *status = (const struct wifi_status *)cb->info;

	if (context.connected) {
		return;
	}
	if (status->status) {
		LOG_ERR("WiFi connection failed (%d)", status->status);
	} else {
		LOG_INF("WiFi connected");
		context.connected = true;
	}
	context.connect_result = true;
}

static void handle_wifi_disconnect_result(struct net_mgmt_event_callback *cb)
{
	const struct wifi_status *status = (const struct wifi_status *)cb->info;

	if (!context.connected) {
		return;
	}
	if (context.disconnect_requested) {
		LOG_INF("WiFi disconnect %s (%d)",
			status->status ? "failed" : "done", status->status);
		context.disconnect_requested = false;
	} else {
		LOG_INF("WiFi disconnected");
		context.connected = false;
	}
	log_wifi_status();
}

static void wifi_mgmt_event_handler(struct net_mgmt_event_callback *cb,
				    uint64_t mgmt_event,
				    struct net_if *iface)
{
	ARG_UNUSED(iface);
	switch (mgmt_event) {
	case NET_EVENT_WIFI_CONNECT_RESULT:
		handle_wifi_connect_result(cb);
		break;
	case NET_EVENT_WIFI_DISCONNECT_RESULT:
		handle_wifi_disconnect_result(cb);
		break;
	default:
		break;
	}
}

static void on_dhcp_bound(struct net_mgmt_event_callback *cb)
{
	const struct net_if_dhcpv4 *dhcpv4 = cb->info;
	char addr_str[NET_IPV4_ADDR_LEN];

	net_addr_ntop(AF_INET, &dhcpv4->requested_ip, addr_str, sizeof(addr_str));
	LOG_INF("DHCP bound: %s", addr_str);

	int ret = bridge_start();
	if (ret) {
		LOG_ERR("bridge_start returned %d", ret);
	}
}

static void net_mgmt_event_handler(struct net_mgmt_event_callback *cb,
				   uint64_t mgmt_event,
				   struct net_if *iface)
{
	ARG_UNUSED(iface);
	if (mgmt_event == NET_EVENT_IPV4_DHCP_BOUND) {
		on_dhcp_bound(cb);
	}
}

static int wifi_connect(void)
{
	struct net_if *iface = net_if_get_first_wifi();

	context.connected = false;
	context.connect_result = false;

	if (net_mgmt(NET_REQUEST_WIFI_CONNECT_STORED, iface, NULL, 0)) {
		LOG_ERR("WiFi connect request failed");
		return -ENOEXEC;
	}
	LOG_INF("WiFi connect requested");
	return 0;
}

static int start_app(void)
{
	while (1) {
#ifdef CONFIG_WIFI_READY_LIB
		LOG_INF("Waiting for WiFi to be ready");
		int ret = k_sem_take(&wifi_ready_state_changed_sem, K_FOREVER);
		if (ret) {
			LOG_ERR("Failed to take WiFi-ready semaphore: %d", ret);
			return ret;
		}
check_wifi_ready:
		if (!wifi_ready_status) {
			LOG_INF("WiFi is not ready");
			continue;
		}
#endif

		wifi_connect();
		while (!context.connect_result) {
			log_wifi_status();
			k_sleep(K_MSEC(STATUS_POLLING_MS));
		}

		if (context.connected) {
			log_wifi_status();
#ifdef CONFIG_WIFI_READY_LIB
			ret = k_sem_take(&wifi_ready_state_changed_sem, K_FOREVER);
			if (ret) {
				LOG_ERR("Failed to take WiFi-ready semaphore: %d", ret);
				return ret;
			}
			goto check_wifi_ready;
#else
			k_sleep(K_FOREVER);
#endif
		}
	}
	return 0;
}

#ifdef CONFIG_WIFI_READY_LIB
static void start_wifi_thread_fn(void);
#define START_WIFI_THREAD_PRIO K_PRIO_COOP(CONFIG_NUM_COOP_PRIORITIES - 1)
K_THREAD_DEFINE(start_wifi_thread_id,
		CONFIG_BRIDGE_WIFI_START_STACK_SIZE,
		start_wifi_thread_fn, NULL, NULL, NULL,
		START_WIFI_THREAD_PRIO, 0, -1);

static void start_wifi_thread_fn(void)
{
	start_app();
}

static void wifi_ready_cb(bool ready)
{
	LOG_DBG("WiFi ready? %s", ready ? "yes" : "no");
	wifi_ready_status = ready;
	k_sem_give(&wifi_ready_state_changed_sem);
}

static int register_wifi_ready_(void)
{
	wifi_ready_callback_t cb = { .wifi_ready_cb = wifi_ready_cb };
	struct net_if *iface = net_if_get_first_wifi();

	if (!iface) {
		LOG_ERR("No WiFi interface");
		return -1;
	}
	int ret = register_wifi_ready_callback(cb, iface);
	if (ret) {
		LOG_ERR("Failed to register WiFi-ready callback: %s", strerror(ret));
	}
	return ret;
}
#endif

static void mgmt_callbacks_init(void)
{
	net_mgmt_init_event_callback(&wifi_mgmt_cb, wifi_mgmt_event_handler,
				     WIFI_SHELL_MGMT_EVENTS);
	net_mgmt_add_event_callback(&wifi_mgmt_cb);

	net_mgmt_init_event_callback(&net_mgmt_cb, net_mgmt_event_handler,
				     NET_EVENT_IPV4_DHCP_BOUND);
	net_mgmt_add_event_callback(&net_mgmt_cb);

	LOG_INF("Starting %s with CPU frequency: %d MHz", CONFIG_BOARD,
		SystemCoreClock / MHZ(1));
	k_sleep(K_SECONDS(1));
}

int main(void)
{
	mgmt_callbacks_init();

#ifdef CONFIG_WIFI_READY_LIB
	int ret = register_wifi_ready_();
	if (ret) {
		return ret;
	}
	k_thread_start(start_wifi_thread_id);
#else
	start_app();
#endif
	return 0;
}
```

## src/radio_154.c
```c
/*
 * IEEE 802.15.4 driver wrapper.
 *
 * Radio bring-up: driver init via SYS_INIT, then channel / auto-ACK /
 * PAN ID / extended address set in radio_154_init(), then enter RX.
 *
 * RX path: nrf_802154_received_raw allocates a bridge_frame from
 * rx_slab, copies the PSDU bytes (and rssi/lqi) in, and pushes a
 * pointer onto rx_msgq. receive_802_15_4 drains the msgq, copies the
 * frame out for the caller, and frees the slab entry.
 *
 * transmit_802_15_4 is still -ENOSYS (later step).
 */

#include "bridge.h"

#include <errno.h>
#include <stdint.h>
#include <zephyr/init.h>
#include <zephyr/kernel.h>
#include <zephyr/logging/log.h>
#include <zephyr/sys/printk.h>
#include <zephyr/sys/util.h>

#include "nrf_802154.h"

LOG_MODULE_REGISTER(radio_154, CONFIG_LOG_DEFAULT_LEVEL);

/* RX slab: backing storage for received bridge_frame instances.
 * Block size is rounded up to a 4-byte multiple as K_MEM_SLAB_DEFINE
 * requires alignment-multiple block size. */
#define RX_SLAB_BLOCK_SIZE  ROUND_UP(sizeof(struct bridge_frame), 4)
#define RX_SLAB_ALIGN       4

K_MEM_SLAB_DEFINE(rx_slab, RX_SLAB_BLOCK_SIZE,
		  CONFIG_BRIDGE_RX_SLAB_DEPTH, RX_SLAB_ALIGN);

/* RX msgq: holds bridge_frame * pointers (into rx_slab). */
K_MSGQ_DEFINE(rx_msgq, sizeof(struct bridge_frame *),
	      CONFIG_BRIDGE_RX_SLAB_DEPTH, sizeof(void *));

static int rf_setup(void)
{
	LOG_INF("RF setup started");
	printk("RF setup started\n");
	nrf_802154_init();
	return 0;
}

SYS_INIT(rf_setup, POST_KERNEL, 90);

void nrf_802154_received_raw(uint8_t *data, int8_t power, uint8_t lqi)
{
	/* TODO: populate the RX path.
	 *
	 * nrf_802154 hands back PHR + PSDU: data[0] = PSDU length (includes
	 * the 2-byte FCS), data[1..1+data[0]] = PSDU bytes.
	 *
	 *   1. Read psdu_len = data[0]; drop if 0 or > BRIDGE_FRAME_MAX_LEN.
	 *   2. k_mem_slab_alloc(&rx_slab, &frame, K_NO_WAIT). On failure, drop.
	 *   3. frame->len = psdu_len; frame->rssi = power; frame->lqi = lqi;
	 *      memcpy(frame->data, &data[1], psdu_len).
	 *   4. nrf_802154_buffer_free_raw(data) so the radio can reuse the buffer.
	 *   5. k_msgq_put(&rx_msgq, &frame, K_NO_WAIT). If full, k_mem_slab_free.
	 *
	 * Until populated, just release the driver buffer so RX doesn't stall.
	 */
	 
	uint8_t pdsu_len = data[0];
	if (pdsu_len == 0 || pdsu_len > BRIDGE_FRAME_MAX_LEN) {
		return;
	}

	struct bridge_frame * frame;
	if (k_mem_slab_alloc(&rx_slab, &frame, K_NO_WAIT) != 0) {
		return;
	}

	frame->len = pdsu_len;
	frame->rssi = power;
	frame->lqi = lqi;
	memcpy(frame->data, data + 1, pdsu_len);

	nrf_802154_buffer_free_raw(data);

	if (k_msgq_put(&rx_msgq, &frame, K_NO_WAIT) == 0) {
		LOG_DBG("Added message to the queue");
	} else {
		LOG_WRN("Msg queue is full");
	}
}

int radio_154_init(void)
{
	
	struct net_if *iface;
	// int ret;
	// ret = net_promisc_mode_on(iface);

	// if (ret < 0) {
	// 	if (ret == -EALREADY) {
	// 		LOG_ERR("Promiscuous mode already enabld");
	// 	} else {
	// 		LOG_ERR("Cannot set promiscuous mode for interface %p (%d)\n", iface, ret);
	// 	}
	// 	return -ENOEXEC;
	// }

	// pkt = net_promisc_mode_wait_data(K_FOREVER);
	
	nrf_802154_channel_set(CONFIG_BRIDGE_15_4_CHANNEL);
	nrf_802154_auto_ack_set(true);
	LOG_DBG("channel: %u", nrf_802154_channel_get());

	/* PAN ID, little-endian wire order. */
	uint8_t pan_id[2] = {
		CONFIG_BRIDGE_15_4_PAN_ID & 0xff,
		(CONFIG_BRIDGE_15_4_PAN_ID >> 8) & 0xff,
	};
	nrf_802154_pan_id_set(pan_id);

	
	uint8_t extended_addr[8] = {
		0x50, 0xbe, 0xca, 0xc3, 0x3c, 0x36, 0xce, 0xf4,
	};
	nrf_802154_extended_address_set(extended_addr);

	if (nrf_802154_receive()) {
		LOG_INF("radio entered rx state");
		return 0;
	}
	LOG_ERR("driver could not enter the receive state");
	return -EIO;
}

// callback fn for successful tx
void nrf_802154_transmitted_raw(uint8_t *p_frame,
	const nrf_802154_transmit_done_metadata_t *p_metadata) {
	LOG_INF("frame was transmitted!");
}

int transmit_802_15_4(const struct bridge_frame *pkt)
{
	nrf_802154_channel_set(23u); //edited! change back to 23
	LOG_DBG("channel: %u", nrf_802154_channel_get());

	// set the pan_id (2 bytes, little-endian)
	uint8_t src_pan_id[] = {0xbb, 0xbb};;
	nrf_802154_pan_id_set(src_pan_id);

	// set the extended address (8 bytes, little-endian)
	uint8_t src_extended_addr[] = {0xdc, 0xa9, 0x35, 0x7b, 0x73, 0x36, 0xce, 0xf4};

 	uint8_t dst_extended_addr[] = {0x50, 0xbe, 0xca, 0xc3, 0x3c, 0x22, 0x11, 0x00}; //edited!
	//uint8_t dst_short_addr[] = {0x12, 0x34}; 
	
	const nrf_802154_transmit_metadata_t metadata = {
		.frame_props = NRF_802154_TRANSMITTED_FRAME_PROPS_DEFAULT_INIT,
		.cca = true
	};

	//send packet
	while(1){
		int err;
		nrf_802154_transmitted_raw(pkt->data, &metadata);

		if(err){
			LOG_ERR("driver could not schedule the transmission procedure. Reason Ox%x", err);
            printk("Reason Ox%x", err);
		}
		// sleep for 1 seconds
		k_sleep(K_MSEC(1000));
	}
	return 0;
	//ARG_UNUSED(pkt);
	//return -ENOSYS;
}

int receive_802_15_4(struct bridge_frame *pkt, k_timeout_t timeout)
{
	/* TODO: populate the consumer side.
	 *
	 *   1. Validate pkt is non-NULL (-EINVAL if not).
	 *   2. struct bridge_frame *frame;
	 *      ret = k_msgq_get(&rx_msgq, &frame, timeout);
	 *      -- returns -EAGAIN on timeout when caller passes K_NO_WAIT or K_MSEC.
	 *   3. memcpy(pkt, frame, sizeof(*pkt)).
	 *   4. k_mem_slab_free(&rx_slab, frame).
	 *   5. return 0.
	 */
	if (pkt == NULL) {
		return -EINVAL;
	}

	// get msg from q
	struct bridge_frame * frame;
	if(k_msgq_get(&rx_msgq, &frame, timeout) != 0) {
		return -EAGAIN;
	}

	// copy packet and free
	memcpy(pkt, frame, sizeof(*pkt));
	k_mem_slab_free(&rx_slab, frame);
	
	return 0;
}

unsigned int radio_154_rx_pending(void)
{
	return k_msgq_num_used_get(&rx_msgq);
}

void radio_154_rx_purge(void)
{
	struct bridge_frame *frame;
	while (k_msgq_get(&rx_msgq, &frame, K_NO_WAIT) == 0) {
		k_mem_slab_free(&rx_slab, frame);
	}
}
```

## src/tunnel.c
```c
/*
 * TCP tunnel to the relay server.
 *
 * Step 4: tunnel_init() spawns a connection-management thread that
 * establishes a long-lived TCP socket to BRIDGE_RELAY_HOST:BRIDGE_RELAY_PORT,
 * sends a HELLO carrying BRIDGE_TUNNEL_ID, and reconnects with backoff
 * on failure. tunnel_packet() snapshots the fd under a mutex and writes
 * a single length-prefixed FRAME message; on send failure it marks the
 * fd dead and signals the connection thread to reconnect.
 *
 * receive_tunnel_packet() is still -ENOSYS (step 5).
 *
 * BRIDGE_RELAY_HOST is parsed as an IPv4 literal via zsock_inet_pton.
 * Hostname support would need CONFIG_DNS_RESOLVER and getaddrinfo.
 */

#include "bridge.h"

#include <errno.h>
#include <stdbool.h>
#include <stdint.h>
#include <string.h>

#include <zephyr/kernel.h>
#include <zephyr/logging/log.h>
#include <zephyr/net/socket.h>
#include <zephyr/sys/util.h>
#include <zephyr/toolchain.h>

LOG_MODULE_REGISTER(tunnel, CONFIG_LOG_DEFAULT_LEVEL);

#define TUNNEL_MAGIC       0x34353142u  /* 'B154' little-endian */
#define TUNNEL_VERSION     1
#define MSG_HELLO          1
#define MSG_FRAME          2
#define HELLO_PAYLOAD_LEN  16

#define RECONNECT_BACKOFF_MIN_MS  1000
#define RECONNECT_BACKOFF_MAX_MS  30000

#define CONNECTION_THREAD_STACK   4096
#define RECV_THREAD_STACK 	      4096

struct __packed tunnel_hdr {
	uint32_t magic;
	uint8_t  version;
	uint8_t  msg_type;
	uint16_t seq;
	int8_t   rssi;
	uint8_t  lqi;
	uint8_t  len;
	uint8_t  _pad;
};

BUILD_ASSERT(sizeof(struct tunnel_hdr) == 12, "tunnel_hdr must be 12 bytes");

static K_MUTEX_DEFINE(fd_mutex);
static int sock_fd = -1;            /* protected by fd_mutex */
static K_SEM_DEFINE(reconnect_sem, 0, 1);

static K_THREAD_STACK_DEFINE(connection_stack, CONNECTION_THREAD_STACK);
static struct k_thread connection_thread;

static K_THREAD_STACK_DEFINE(recv_thread_stack, RECV_THREAD_STACK);
static struct k_thread recv_thread;

static uint16_t tx_seq;              /* only touched by tunnel_packet */

/* Send `len` bytes; loops over short writes. Returns 0 or -errno. */
static int send_all(int fd, const void *buf, size_t len)
{
	const uint8_t *p = buf;
	while (len > 0) {
		int n = zsock_send(fd, p, len, 0);
		if (n < 0) {
			return -errno;
		}
		if (n == 0) {
			return -ECONNRESET;
		}
		p += n;
		len -= n;
	}
	return 0;
}

/* Open + connect + HELLO. Returns the connected fd, or a negative errno. */
static int do_connect(void)
{
	struct sockaddr_in addr = {
		.sin_family = AF_INET,
		.sin_port = htons(CONFIG_BRIDGE_RELAY_PORT),
	};

	if (zsock_inet_pton(AF_INET, CONFIG_BRIDGE_RELAY_HOST, &addr.sin_addr) != 1) {
		LOG_ERR("BRIDGE_RELAY_HOST='%s' is not a valid IPv4 literal "
			"(hostname support needs CONFIG_DNS_RESOLVER + getaddrinfo)",
			CONFIG_BRIDGE_RELAY_HOST);
		return -EINVAL;
	}

	int fd = zsock_socket(AF_INET, SOCK_STREAM, IPPROTO_TCP);
	if (fd < 0) {
		return -errno;
	}

	if (zsock_connect(fd, (struct sockaddr *)&addr, sizeof(addr)) < 0) {
		int e = -errno;
		zsock_close(fd);
		return e;
	}

	int one = 1;
	if (zsock_setsockopt(fd, IPPROTO_TCP, TCP_NODELAY, &one, sizeof(one)) < 0) {
		LOG_WRN("TCP_NODELAY failed: %d (continuing without it)", errno);
	}

	/* HELLO: header + 16-byte zero-padded ASCII tunnel_id. */
	uint8_t buf[sizeof(struct tunnel_hdr) + HELLO_PAYLOAD_LEN] = {0};
	struct tunnel_hdr hdr = {
		.magic = TUNNEL_MAGIC,
		.version = TUNNEL_VERSION,
		.msg_type = MSG_HELLO,
		.len = HELLO_PAYLOAD_LEN,
	};
	memcpy(buf, &hdr, sizeof(hdr));
	strncpy((char *)buf + sizeof(hdr), CONFIG_BRIDGE_TUNNEL_ID, HELLO_PAYLOAD_LEN);

	int ret = send_all(fd, buf, sizeof(buf));
	if (ret < 0) {
		LOG_WRN("HELLO send failed: %d", ret);
		zsock_close(fd);
		return ret;
	}

	return fd;
}

/* Close the fd if it still matches `expected_fd`, and signal a reconnect. */
static void mark_dead(int expected_fd)
{
	bool need_signal = false;
	k_mutex_lock(&fd_mutex, K_FOREVER);
	if (sock_fd >= 0 && sock_fd == expected_fd) {
		zsock_close(sock_fd);
		sock_fd = -1;
		need_signal = true;
	}
	k_mutex_unlock(&fd_mutex);
	if (need_signal) {
		k_sem_give(&reconnect_sem);
	}
}

static void connection_thread_fn(void *a, void *b, void *c)
{
	ARG_UNUSED(a); ARG_UNUSED(b); ARG_UNUSED(c);

	LOG_INF("tunnel connection thread started");
	uint32_t backoff_ms = RECONNECT_BACKOFF_MIN_MS;

	while (1) {
		int fd = do_connect();
		if (fd < 0) {
			LOG_WRN("connect to %s:%d failed: %d, retrying in %u ms",
				CONFIG_BRIDGE_RELAY_HOST, CONFIG_BRIDGE_RELAY_PORT,
				fd, backoff_ms);
			k_sleep(K_MSEC(backoff_ms));
			backoff_ms = MIN(backoff_ms * 2, RECONNECT_BACKOFF_MAX_MS);
			continue;
		}

		backoff_ms = RECONNECT_BACKOFF_MIN_MS;
		k_mutex_lock(&fd_mutex, K_FOREVER);
		sock_fd = fd;
		k_mutex_unlock(&fd_mutex);
		LOG_INF("tunnel connected to %s:%d (fd=%d, tunnel_id='%s')",
			CONFIG_BRIDGE_RELAY_HOST, CONFIG_BRIDGE_RELAY_PORT,
			fd, CONFIG_BRIDGE_TUNNEL_ID);

		/* Block until something marks the connection dead. */
		k_sem_take(&reconnect_sem, K_FOREVER);
		LOG_INF("tunnel: reconnecting");
	}
}

static void receive_thread_fn(void * a, void * b, void * c) {
	ARG_UNUSED(a); ARG_UNUSED(b); ARG_UNUSED(c);

	while (1) {
		struct bridge_frame pkt;
		receive_tunnel_packet(&pkt, K_MSEC(10));

		k_sleep(K_MSEC(100));
	}
}

int tunnel_init(void)
{
	k_thread_create(&connection_thread, connection_stack,
			K_THREAD_STACK_SIZEOF(connection_stack),
			connection_thread_fn, NULL, NULL, NULL,
			K_PRIO_PREEMPT(7), 0, K_NO_WAIT);
	k_thread_name_set(&connection_thread, "tunnel-conn");

	k_thread_create(&recv_thread, recv_thread_stack,
			K_THREAD_STACK_SIZEOF(recv_thread_stack),
			receive_thread_fn, NULL, NULL, NULL,
			K_PRIO_PREEMPT(7), 0, K_NO_WAIT);
	k_thread_name_set(&recv_thread, "recv-tun");
	
	return 0;
}

int tunnel_packet(const struct bridge_frame *pkt)
{
	if (!pkt || pkt->len > BRIDGE_FRAME_MAX_LEN) {
		return -EINVAL;
	}

	int fd;
	k_mutex_lock(&fd_mutex, K_FOREVER);
	fd = sock_fd;
	k_mutex_unlock(&fd_mutex);

	if (fd < 0) {
		return -ENOTCONN;
	}

	/* One send: header + payload concatenated, so the relay reads a
	 * complete (hdr + len) unit even if the underlying TCP segments
	 * fragment differently. */
	uint8_t buf[sizeof(struct tunnel_hdr) + BRIDGE_FRAME_MAX_LEN];
	struct tunnel_hdr hdr = {
		.magic = TUNNEL_MAGIC,
		.version = TUNNEL_VERSION,
		.msg_type = MSG_FRAME,
		.seq = tx_seq++,
		.rssi = pkt->rssi,
		.lqi = pkt->lqi,
		.len = pkt->len,
	};
	memcpy(buf, &hdr, sizeof(hdr));
	if (pkt->len > 0) {
		memcpy(buf + sizeof(hdr), pkt->data, pkt->len);
	}

	int ret = send_all(fd, buf, sizeof(hdr) + pkt->len);
	if (ret < 0) {
		LOG_DBG("tunnel_packet send failed: %d, marking fd dead", ret);
		mark_dead(fd);
	}
	return ret;
}

int receive_tunnel_packet(struct bridge_frame *pkt, k_timeout_t timeout)
{
	// get socket fd
	int fd;
	k_mutex_lock(&fd_mutex, K_FOREVER);
	fd = sock_fd;
	k_mutex_unlock(&fd_mutex);

	if (fd < 0) {
		return -ENOTCONN;
	}

	// recv msg from socket
	uint8_t buf[sizeof(struct tunnel_hdr) + BRIDGE_FRAME_MAX_LEN];
	size_t len = zsock_recv (fd, buf, sizeof(struct tunnel_hdr) + BRIDGE_FRAME_MAX_LEN, 0);
	if (len <= sizeof(struct tunnel_hdr)) {
		return -ENOTCONN;
	}

	// populate packet
	struct tunnel_hdr header;
	memcpy(&header, buf, sizeof(header));
	memcpy(pkt, buf + sizeof(header), len - sizeof(header));

	// transmit packet over 802.15.4
	return transmit_802_15_4(pkt);
}
```
